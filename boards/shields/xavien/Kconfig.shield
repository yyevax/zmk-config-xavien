## boards/shields/xavien/Kconfig.shield
```kconfig
# Copyright (c) 2020 The ZMK Contributors
# SPDX-License-Identifier: MIT

config SHIELD_XAVIEN_LEFT
	def_bool $(shields_list_contains,xavien_left)

config SHIELD_XAVIEN_RIGHT
	def_bool $(shields_list_contains,xavien_right)

config SHIELD_XAVIEN_DONGLE
	def_bool $(shields_list_contains,xavien_dongle)
```

## config/west.yml
```yaml
manifest:
  remotes:
    - name: upstream
      url-base: https://github.com/zmkfirmware
    - name: zmkfirmware
      url-base: https://github.com/zmkfirmware
    - name: caksoylar
      url-base: https://github.com/caksoylar
    - name: urob
      url-base: https://github.com/urob
    - name: duanexavierbondad
      url-base: https://github.com/duanexavierbondad
  projects:
    - name: zmk
      remote: duanexavierbondad
      revision: caksoylar/experimental
      import: app/west.yml
    - name: zmk-rgbled-widget
      remote: caksoylar
      revision: main
    - name: zmk-tri-state
      remote: caksoylar
      revision: main
    - name: zmk-helpers
      remote: urob
      revision: main
  self:
    path: config
```
